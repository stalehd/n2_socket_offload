## CMakeLists.txt
```
cmake_minimum_required(VERSION 3.13.1)
include($ENV{ZEPHYR_BASE}/cmake/app/boilerplate.cmake NO_POLICY_SCOPE)
project(n2_offload)

FILE(GLOB app_sources src/*.c*)
target_sources(app PRIVATE ${app_sources})
```

## prj.conf
```kconfig
CONFIG_LOG=y
CONFIG_NETWORKING=y
CONFIG_NET_SOCKETS=y
CONFIG_NET_SOCKETS_POSIX_NAMES=y
CONFIG_NET_SOCKETS_OFFLOAD=y
CONFIG_NET_IPV4=y
CONFIG_NET_UDP=y
CONFIG_NET_OFFLOAD=y
CONFIG_HAS_SEGGER_RTT=y
CONFIG_USE_SEGGER_RTT=y
CONFIG_RTT_CONSOLE=y
CONFIG_UART_CONSOLE=n
CONFIG_UART_INTERRUPT_DRIVEN=y
CONFIG_SERIAL=y
CONFIG_RING_BUFFER=y
CONFIG_HEAP_MEM_POOL_SIZE=8192
CONFIG_MAIN_STACK_SIZE=4096
CONFIG_SYSTEM_WORKQUEUE_STACK_SIZE=4096
CONFIG_HW_STACK_PROTECTION=y
# This is just for logging.
CONFIG_LOG_IMMEDIATE=n
CONFIG_LOG_STRDUP_BUF_COUNT=10
CONFIG_STDOUT_CONSOLE=y


CONFIG_COAP=y
# FOTA setup
CONFIG_LWM2M=y
CONFIG_LWM2M_IPSO_SUPPORT=n
CONFIG_NET_STATISTICS=n
#CONFIG_NET_CONFIG_PEER_IPV4_ADDR="172.16.15.14"
CONFIG_LWM2M_FIRMWARE_UPDATE_PULL_SUPPORT=y
CONFIG_LWM2M_FIRMWARE_UPDATE_OBJ_SUPPORT=y
CONFIG_LWM2M_RD_CLIENT_SUPPORT=y
CONFIG_LWM2M_ENGINE_DEFAULT_LIFETIME=1800
CONFIG_LWM2M_RD_CLIENT_SUPPORT_BOOTSTRAP=n
CONFIG_LWM2M_LOG_LEVEL_INF=y
CONFIG_DEBUG=y


# Flash
CONFIG_REBOOT=y
CONFIG_FLASH=y
CONFIG_FLASH_PAGE_LAYOUT=y
CONFIG_BOOTLOADER_MCUBOOT=y
CONFIG_IMG_MANAGER=y
CONFIG_MCUBOOT_IMG_MANAGER=y
CONFIG_MPU_ALLOW_FLASH_WRITE=y

# hansj

# Frame buffer
CONFIG_CHARACTER_FRAMEBUFFER=y
# I2C
CONFIG_I2C=y
# SPI
CONFIG_SPI=y
CONFIG_SPI_1=y
# GPIO
CONFIG_GPIO=y
CONFIG_HAS_HW_NRF_GPIO0=y
CONFIG_GPIO_NRFX=y
#UART
CONFIG_SERIAL=y
CONFIG_UART_INTERRUPT_DRIVEN=y
CONFIG_UART_0_NRF_UART=y
#THREADS
CONFIG_NUM_COOP_PRIORITIES=10
CONFIG_NUM_PREEMPT_PRIORITIES=10
#Floating point
CONFIG_NEWLIB_LIBC=n


# CoAP needs more time. Roundtrips are *slow* through the modem
#CONFIG_COAP_INIT_ACK_TIMEOUT=10000
CONFIG_COAP_INIT_ACK_TIMEOUT_MS=20000
CONFIG_LWM2M_COAP_BLOCK_SIZE=256
CONFIG_LWM2M_ENGINE_STACK_SIZE=4096
CONFIG_LWM2M_ENGINE_MAX_PENDING=5
CONFIG_LWM2M_RW_JSON_SUPPORT=n
CONFIG_LWM2M_SECURITY_INSTANCE_COUNT=1
CONFIG_LWM2M_SERVER_INSTANCE_COUNT=2
# This is an OH FOR FUCKS SAKE I DON'T NEED THIS
CONFIG_COAP_EXTENDED_OPTIONS_LEN=y
CONFIG_COAP_EXTENDED_OPTIONS_LEN_VALUE=17
```

## src/main.c
```c
/*
    Copyright 2020 Telenor Digital AS

    Licensed under the Apache License, Version 2.0 (the "License");
    you may not use this file except in compliance with the License.
    You may obtain a copy of the License at

    http://www.apache.org/licenses/LICENSE-2.0

    Unless required by applicable law or agreed to in writing, software
    distributed under the License is distributed on an "AS IS" BASIS,
    WITHOUT WARRANTIES OR CONDITIONS OF ANY KIND, either express or implied.
    See the License for the specific language governing permissions and
    limitations under the License.
*/

#include "config.h"
#include <stdio.h>

#include <zephyr.h>
#include <drivers/gpio.h>
#include <net/socket.h>
#include "fota.h"
#include "test_udp.h"
#include "test_coap.h"
#include "test_modem.h"
#include "panic.h"

void testFOTA()
{
    // Initialize the application and run any self-tests before calling fota_init.
    // Otherwise, if initialization or self-tests fail after an update, reboot the system and the previous firmware image will be used.
    k_sleep(1000);
    int ret = fota_init();
    if (ret)
    {
        printf("fota_init: %d\n", ret);
        return;
    }
    printf("Returned from fota_init()\n");
    // Loop forever
    #if 1
     while (true)
    {
        k_sleep(5000);
    }
    #else

    char buf[12];
    int counter = 0;

    int err = 0;
    int sock = socket(AF_INET, SOCK_DGRAM, IPPROTO_UDP);
    if (sock < 0)
    {
        printf("Error opening socket: %d\n", sock);
        return;
    }
    static struct sockaddr_in remote_addr = {
                sin_family : AF_INET,
    };
    remote_addr.sin_port = htons(1234);

    net_addr_pton(AF_INET, "172.16.15.14", &remote_addr.sin_addr);

    err = connect(sock, (struct sockaddr *)&remote_addr, sizeof(remote_addr));
    if (err < 0) {
        printf("Error connecting: %d", err);
        close(sock);
        return;
    }
    while (true)
    {
        sprintf(buf, "Keepalive%d", counter);
        err = send(sock, buf, strlen(buf), 0);
        if (err < strlen(buf))
        {
            printf("Error sending: %d\n", err);
            close(sock);
            return;
        }
        printf("%d:%s\n", sock, buf);
        // Send keepalive messages every 5 seconds
        k_sleep(5000);
        counter++;
    }
    close(sock);
    #endif
}

void main(void)
{

    //init_panic();

    printf("Start\n");

    testUDP();

    printf("Halting firmware\n");
}
```

## src/at_commands.c
```c
#include <zephyr.h>
#include <stdio.h>
#include <stdbool.h>
#include <string.h>
#include <ctype.h>
#include "at_commands.h"
#include "comms.h"

#include <logging/log.h>
#define LOG_LEVEL LOG_LEVEL_DBG
LOG_MODULE_REGISTER(at_commands);

#define CMD_TIMEOUT K_MSEC(2000)
#define CMD_REBOOT_TIMEOUT K_MSEC(15000)

// Ring buffer size. The ring buffer holds just enough bytes to detect the
// different responses/fields.
#define B_SIZE 10

struct buf
{
    uint8_t data[B_SIZE];
    uint8_t index;
    uint16_t size;
};

void b_reset(struct buf *rb)
{
    rb->index = 0;
    rb->size = 0;
    // this can be skipped
    memset(rb->data, 0, B_SIZE);
}

void b_init(struct buf *rb)
{
    b_reset(rb);
}
void b_add(struct buf *rb, uint8_t b)
{
    if (rb->index < B_SIZE)
    {
        rb->data[rb->index++] = b;
    }
    rb->size++;
}

bool b_is(struct buf *rb, const char *str, const size_t len)
{
    if (strncmp((char *)rb->data, str, len) == 0)
    {
        return true;
    }
    return false;
}

bool b_is_urc(struct buf *rb)
{
    return (rb->size > 0 && rb->data[0] == '+');
}

// Callbacks for the input processing. The context is used to maintain variables
// between the invocations and are passed by the decode_input function below.
typedef void (*eol_callback_t)(void *ctx, struct buf *rb, bool is_urc);
typedef void (*char_callback_t)(void *ctx, struct buf *rb, char b, bool is_urc, bool is_space);

// Each decoder is largely the same so we use a strategy pattern for each. The char
// callback is called for each character input and the EOL callback is called when a
// new line is found. The buffer will contain the *first* 9 characters of the line
// so it might be truncated.
//
int decode_input(int32_t timeout, void *ctx, char_callback_t char_cb, eol_callback_t eol_cb)
{
    bool printchar = false;
    if (timeout < 0) {
        timeout = -timeout;
        printchar = true;
        printf("AT+NSORF dump:\n");
    }
    struct buf rb;
    b_init(&rb);
    uint8_t b, prev = ' ';
    bool is_urc = false;

    while (modem_read(&b, timeout))
    {
        if (b == '+' && rb.size == 0)
        {
            is_urc = true;
        }
        b_add(&rb, b);
        if (printchar) {
            printf("%c", b);
        }
        if (char_cb)
        {
            char_cb(ctx, &rb, b, is_urc, isspace(b));
        }
        if (rb.size >= 4)
        {
            if (b_is(&rb, "OK\r\n", 4))
            {
                if (printchar) {
                    printf("\nOK AT+NSORF dump\n");
                }
                return AT_OK;
            }
            if (b_is(&rb, "ERROR\r\n", 7))
            {
                if (printchar) {
                    printf("\nERROR AT+NSORF dump\n");
                }
                return AT_ERROR;
            }
        }
        if (prev == '\r' && b == '\n')
        {
            if (eol_cb)
            {
                eol_cb(ctx, &rb, is_urc);
            }
            b_reset(&rb);
            is_urc = false;
        }
        // Additional URCs to support:
        //  - CEREG
        //  - NPSMR
        //  - CSCON
        //  - UFOTAS

        prev = b;
    }
    if (printchar) {
        printf("\nTIMEOUT AT+NSORF dump\n");
    }
    return AT_TIMEOUT;
}

int atnrb_decode()
{
    return decode_input(CMD_REBOOT_TIMEOUT, NULL, NULL, NULL);
}

// Just wait for OK or ERROR
int atnsocl_decode()
{
    return decode_input(CMD_TIMEOUT, NULL, NULL, NULL);
}

// Decode the CGPADDR response. The in_address flag says if we're in the address
// string (ie past the +CGPADDR: string) and copies the bytes into the address
// buffer. When the eol callback is set the address flag is reset

struct cgp_ctx
{
    bool in_address;
    uint8_t addrindex;
    char *address;
    char *buffer;
    size_t *len;
    uint8_t i;
};

void cgpaddr_eol(void *ctx, struct buf *rb, bool is_urc)
{
    struct cgp_ctx *c = (struct cgp_ctx *)ctx;
    if (c->in_address)
    {
        bool in_str = false;
        uint8_t n = 0;
        for (int i = 0; i < (c->i); i++)
        {
            if (in_str && c->buffer[i] == '\"')
            {
                in_str = false;
            }
            if (in_str)
            {
                c->address[n++] = c->buffer[i];
            }
            if (!in_str && (c->buffer[i] == '\"'))
            {
                in_str = true;
            }
        }
        c->address[n] = 0;
        *c->len = n;
    }
    c->in_address = false;
}

void cgpaddr_char(void *ctx, struct buf *rb, char b, bool is_urc, bool is_space)
{
    struct cgp_ctx *c = (struct cgp_ctx *)ctx;
    if (c->in_address && !is_space)
    {
        c->buffer[c->i++] = (char)b;
    }
    if (is_urc && rb->size == 9 && b_is(rb, "+CGPADDR:", 9))
    {
        c->in_address = true;
    }
}

int atcgpaddr_decode(char *address, size_t *len)
{
    char buffer[20];
    memset(buffer, 0, sizeof(buffer));
    struct cgp_ctx ctx = {
        .in_address = false,
        .address = address,
        .len = len,
        .buffer = buffer,
        .i = 0,
    };
    return decode_input(CMD_TIMEOUT, &ctx, cgpaddr_char, cgpaddr_eol);
}

// Decode NSCR responses. This is fairly straightforward since there's only
// a single digit that is returned. We'll pass the pointer to the return
// function as the context and assign it when the line ends.

void nsocr_eol(void *ctx, struct buf *rb, bool is_urc)
{
    if (!is_urc && rb->size > 2)
    {
        int *sockfd = (int *)ctx;
        *sockfd = atoi((const char *)rb->data);
    }
}

int atnsocr_decode(int *sockfd)
{
    *sockfd = -2;
    return decode_input(CMD_TIMEOUT, sockfd, NULL, nsocr_eol);
}

// Decode SOST responses. Also quite simple since everything fits into
// the entire 9-byte buffer so we just process the line at EOL.

struct nsost_ctx
{
    int *sockfd;
    size_t *len;
};

void nsost_eol(void *ctx, struct buf *rb, bool is_urc)
{
    struct nsost_ctx *c = (struct nsost_ctx *)ctx;
        // Socket descriptor is *always* a single digit, ie the comma would be
        // the 2nd char
    if (!is_urc && *c->len == 0 && rb->size > 2 && rb->data[1] == ',') {
        *c->sockfd = (int)(rb->data[0] - '0');
        if (*c->sockfd >= 7) {
            LOG_ERR("Socket fd should be <= 6 but is '%c'", rb->data[0]);
        }
        *c->len = atoi(rb->data + 2);
    }
}

int atnsost_decode(int *sock_fd, size_t *sent)
{
    struct nsost_ctx ctx = {
        .sockfd = sock_fd,
        .len = sent,
    };
    return decode_input(CMD_TIMEOUT, &ctx, NULL, nsost_eol);
}

// Decode NSORF responses. Each field is decoded separately and stored off in
// a temporary buffer (except the data field which might be large).
#define FROM_HEX(x) (x - '0' > 9 ? x - 'A' + 10 : x - '0')

#define MAX_FIELD_SIZE 16

struct nsorf_ctx
{
    int *sockfd;
    char *ip;
    int *port;
    uint8_t *data;
    size_t *remaining;
    size_t *received;
    int fieldno;
    int fieldindex;
    char field[MAX_FIELD_SIZE];
    int dataidx;
};

void nsorf_eol(void *ctx, struct buf *rb, bool is_urc)
{
    struct nsorf_ctx *c = (struct nsorf_ctx *)ctx;
    if (!is_urc && c->fieldindex > 0)
    {
        *c->remaining = atoi(c->field);
    }
}

void nsorf_char(void *ctx, struct buf *rb, char b, bool is_urc, bool is_space)
{
    if (is_urc || is_space)
    {
        return;
    }
    struct nsorf_ctx *c = (struct nsorf_ctx *)ctx;

    switch (b)
    {
    case ',':
        c->fieldindex = 0;
        switch (c->fieldno)
        {
        case 0:
            *c->sockfd = atoi(c->field);
            break;
        case 1:
            strcpy(c->ip, c->field);
            break;
        case 2:
            *c->port = atoi(c->field);
            break;
        case 3:
            // ignore
            break;
        case 4:
            // ignore
            break;
        default:
            // Should not encounter field #5 here
            LOG_ERR("Too many fields (%d) in response\n", c->fieldno);
            return;
        }
        memset(c->field, 0, MAX_FIELD_SIZE);
        c->fieldno++;
        break;
    case '\"':
        break;
    default:
        c->field[c->fieldindex++] = b;
        if (c->fieldno == 4 && c->fieldindex == 2)
        {
            c->data[c->dataidx++] = (FROM_HEX(c->field[0]) << 4 | FROM_HEX(c->field[1]));
            (*c->received)++;
            c->fieldindex = 0;
        }
        break;
    }
}

int atnsorf_decode(int *sockfd, char *ip, int *port, uint8_t *data, size_t *received, size_t *remaining)
{
    struct nsorf_ctx ctx = {
        .sockfd = sockfd,
        .ip = ip,
        .port = port,
        .data = data,
        .remaining = remaining,
        .fieldno = 0,
        .fieldindex = 0,
        .dataidx = 0,
        .received = received,
    };
    return decode_input(CMD_TIMEOUT, &ctx, nsorf_char, nsorf_eol);
}

int atcpsms_decode()
{
    return decode_input(CMD_TIMEOUT, NULL, NULL, NULL);
}

int at_decode()
{
    return decode_input(CMD_TIMEOUT, NULL, NULL, NULL);
}

int at_poll(int32_t timeout)
{
    return decode_input(CMD_TIMEOUT, NULL, NULL, NULL);
}

struct cimi_ctx
{
    char *imsi;
    uint8_t index;
    bool done;
};

void cimi_char(void *ctx, struct buf *rb, char b, bool is_urc, bool is_space)
{
    struct cimi_ctx *c = (struct cimi_ctx *)ctx;
    if (!c->done && !is_urc && !is_space)
    {
        struct cimi_ctx *c = (struct cimi_ctx *)ctx;
        c->imsi[c->index++] = b;
    }
}

void cimi_eol(void *ctx, struct buf *rb, bool is_urc)
{
    struct cimi_ctx *c = (struct cimi_ctx *)ctx;
    if (!c->done && c->index > 0)
    {
        c->imsi[c->index] = 0;
        c->done = true;
    }
}

int atcimi_decode(char *imsi)
{
    struct cimi_ctx ctx = {
        .imsi = imsi,
        .index = 0,
        .done = false,
    };
    return decode_input(CMD_TIMEOUT, &ctx, cimi_char, cimi_eol);
}
```

## src/at_commands.h
```c
#pragma once

#include <stdio.h>
#include <stdlib.h>
#include <stdint.h>

#define AT_OK 0
#define AT_ERROR -1
#define AT_TIMEOUT -2

/**
 * @brief  Decode AT+NSORF response. The buffer is read in multiple chunks from
 *         the modem.
 * @return -1 for ERROR response, -2 for timeout, number of bytes decoded otherwise
 * @note   Will swallow URCs and call the appropriate callbacks. The lenght of
 *         the buffer must fit the number of bytes that is returned (it's set in
 *         the NSORF command)
 */
int atnsorf_decode(int *sockfd, char *ip, int *port, uint8_t *data, size_t *received, size_t *remaining);

/**
 * @brief Decode AT+CGPADDR response.
 * @return  0 for OK, -1 for ERROR response, -2 for timeout, lenght of address string otherwise
 * @note Will swallow URCs and call appropriate callbacks.  Address might be "0"
 */
int atcgpaddr_decode(char *address, size_t *len);

/**
 * @brief  Decode AT+NSOCR response. Reads until OK or ERROR is received.
 * @return socket file descriptor for modem, -1 for ERROR response, -2 for timeout
 * @note   Will swallow URCs and call the appropriate callbacks
 */
int atnsocr_decode(int *sockfd);

/**
 * @brief  Decode AT+NSOCL response. Reads until OK or ERROR is received.
 * @return 0 for OK, -1 for ERROR
 * @note   Will swallow URCs and call the appropriate callbacks
 */
int atnsocl_decode();

/**
 * @brief  Decode AT+NSOST response. Reads until OK or ERROR is received.
 * @return 0 for OK, -1 for ERROR, -2 for timeout
 * @note   Will swallow URCs and call the appropriate callbacks
 */
int atnsost_decode(int *sock_fd, size_t *sent);

/**
 * @brief Reads response from AT+NRB command. Reads until OK or ERROR is received.
 * @return 0 for OK, -1 for ERROR response, -2 for timeout, -3 for invalid input
 * @note  Will swallow URCs and call the appropriate callbacks
 */
int atnrb_decode();

/**
 * @brief decode AT+CIMI response from modem
 * @note buffer should have enough room for IMSIs (22 chars)
 */
int atcimi_decode(char *imsi);

int atcpsms_decode();

int at_decode();

/*
 * @brief Poll UART for URCs
 */
int at_poll(int32_t timeout);
```

## src/comms.c
```c
#include "config.h"

#define LOG_LEVEL LOG_LEVEL_INF
#include <logging/log.h>
LOG_MODULE_REGISTER(n2_comms);


#include <zephyr.h>
#include <device.h>
#include <uart.h>
#include <kernel.h>
#include <sys/ring_buffer.h>
#include <errno.h>
#include <stdio.h>
#include <stdlib.h>
#include "comms.h"
#include "at_commands.h"

// Ring buffer for received data
#define RB_SIZE 128
static u8_t buffer[RB_SIZE];
static struct ring_buf rx_rb;
static struct k_sem urc_sem;

// Ring buffer for URCs. These are handled separately
#define URC_SIZE 64
static uint8_t urcbuffer[URC_SIZE];
static struct ring_buf urc_rb;
static struct k_sem rx_sem;


#define URC_THREAD_STACK 512
#define URC_THREAD_PRIORITY (CONFIG_NUM_COOP_PRIORITIES)
#define UART_NAME "UART_0"
#define DUMP_MODEM 0

struct k_thread urc_thread;

K_THREAD_STACK_DEFINE(urc_thread_stack,
                      URC_THREAD_STACK);

static recv_callback_t recv_cb = NULL;

void receive_callback(recv_callback_t receive_cb)
{
    recv_cb = receive_cb;
}

void urc_threadproc(void)
{
    char buf[URC_SIZE];
    uint8_t index = 0;
    uint8_t b = 0;
    while (true)
    {
        k_sem_take(&urc_sem, K_FOREVER);
        if (ring_buf_get(&urc_rb, &b, 1) == 1)
        {
            if (b == '\r')
            {
                // this is a new URC
                buf[index] = 0;
                if (index > 0)
                {
                    if (recv_cb && strncmp(buf, "+NSONMI:", 8) == 0)
                    {
                        // This is a receive notification. Invoke callback
                        char *countptr = NULL;
                        char *fdptr = buf;
                        for (uint8_t i = 0; i < index; i++)
                        {
                            if (buf[i] == ',')
                            {
                                countptr = (buf + i + 1);
                                buf[i] = 0;
                            }
                        }
                        // Note offset -- this is the "+NSONMI: " prefix
                        recv_cb(atoi(fdptr + 9), atoi(countptr));
                    }
                }
                index = 0;
            }
            if (b != '\r' && b != '\n')
            {
                buf[index++] = b;
            }
        }
    }
}
/*
 * Modem comms. It's quite a mechanism - the UART is read from an ISR, then
 * sent to a processing thread via a ring buffer. The processing thread
 * parses the incoming data stream and when OK or ERROR is received the
 * data is forwarded to the consuming library via modem_read_line.
 */

/**
 * @brief The ISR for UART rx
 */
static void uart_isr(void *user_data)
{
    static char prev = '\n';
    static bool in_urc = false;
    struct device *dev = (struct device *)user_data;
    uint8_t data;
    int rx, rb;
    while (uart_irq_update(dev) &&
           uart_irq_rx_ready(dev))
    {
        rx = uart_fifo_read(dev, &data, 1);
        if (rx == 0)
        {
            return;
        }
#if DUMP_MODEM
        printk("%c", data);
#endif
        if (prev == '\n' && data == '+')
        {
            in_urc = true;
        }
        if (in_urc)
        {
            ring_buf_put(&urc_rb, &data, 1);
            k_sem_give(&urc_sem);
        }
        if (in_urc && data == '\r')
        {
            in_urc = false;
        }
        rb = ring_buf_put(&rx_rb, &data, 1);
        if (rb != rx)
        {
            LOG_ERR("RX buffer is full. Bytes pending: %d, written: %d", rx, rb);
            return;
        }
        prev = data;
        k_sem_give(&rx_sem);
    }
}

void modem_write(const char *cmd)
{
#if DUMP_MODEM
    printk("%s", cmd);
#endif
    struct device *uart_dev = device_get_binding(UART_NAME);
	if (!uart_dev) {
		LOG_ERR("Cannot get UART device");
		return;
	}

    for (int i = 0; i < strlen(cmd); i++)
    {
        uart_poll_out(uart_dev, (unsigned char)cmd[i]);
    }
}

bool modem_read(uint8_t *b, int32_t timeout)
{
    switch (k_sem_take(&rx_sem, timeout))
    {
    case 0:
        if (ring_buf_get(&rx_rb, b, 1) == 1)
        {
            return true;
        }
        break;
    default:
        break;
    }
    return false;
}

bool modem_is_ready()
{
    modem_write("AT+CGPADDR\r\n");
    char ip[16];
    size_t len = 0;
    if (atcgpaddr_decode((char *)&ip, &len) == AT_OK)
    {
        if (len > 1)
        {
            return true;
        }
    }
    return false;
}

void modem_restart()
{
    modem_write("AT+NRB\r\n");
    atnrb_decode();
}

void modem_init(void)
{
    k_sem_init(&rx_sem, 0, RB_SIZE);
    ring_buf_init(&rx_rb, RB_SIZE, buffer);
    k_sem_init(&urc_sem, 0, URC_SIZE);
    ring_buf_init(&urc_rb, URC_SIZE, urcbuffer);

    k_thread_create(&urc_thread, urc_thread_stack,
                    K_THREAD_STACK_SIZEOF(urc_thread_stack),
                    (k_thread_entry_t)urc_threadproc,
                    NULL, NULL, NULL, K_PRIO_COOP(URC_THREAD_PRIORITY), 0, K_NO_WAIT);


    struct device *uart_dev = device_get_binding(UART_NAME);
    if (!uart_dev)
    {
        LOG_ERR("Unable to load UART device\n");
        return;
    }

    uart_irq_callback_user_data_set(uart_dev, uart_isr, uart_dev);
    uart_irq_rx_enable(uart_dev);

}
```

## src/comms.h
```c
#pragma once

#define UART_COMMS 1
//#define I2C_COMMS 1

/**
 * @brief Callback for receive notifications.
 */
typedef void (*recv_callback_t)(int fd, size_t bytes);

/**
 * @brief Set callback function for new data notifications. This function is
 *        called whenever a +NSOMNI message is received from the modem.
 * @note  Only a single callback can be registered.
 */
void receive_callback(recv_callback_t receive_cb);

/**
 * @brief Initialize communications
 */
void modem_init(void);

/**
 * @brief Writes a string to the modem.
 * @param *cmd: The string to send
 */
void modem_write(const char *cmd);

/**
 * @brief Read a single character from the modem.
 */
bool modem_read(uint8_t *b, int32_t timeout);

bool modem_is_ready();

void modem_restart();
```

## src/config.h
```c
#pragma once

#define APP_LOG_LEVEL LOG_LEVEL_DBG
#define LOG_LEVEL_N2 LOG_LEVEL_INF
#define UART_COMMS 1
//#define I2C_COMMS 1

// 2 second timeout for commands. This is ample time<
#define MDM_CMD_TIMEOUT 2

#define CONFIG_N2_NAME "SARA_N2"
// Priority should be higher than the lwm2m service
#define CONFIG_N2_INIT_PRIORITY 35
#define CONFIG_N2_MAX_PACKET_SIZE 512
```

## src/fota.c
```c
#include <zephyr.h>
#include <logging/log.h>

#include <dfu/mcuboot.h>
#include <dfu/flash_img.h>
#include <misc/reboot.h>
#include <net/lwm2m.h>
#include <stdio.h>

#include "fota.h"


LOG_MODULE_REGISTER(fota, LOG_LEVEL_DBG);

#define FLASH_AREA_IMAGE_SECONDARY DT_FLASH_AREA_IMAGE_1_ID
#define FLASH_BANK1_ID DT_FLASH_AREA_IMAGE_1_ID
#define FLASH_BANK_SIZE DT_FLASH_AREA_IMAGE_1_SIZE

static struct k_delayed_work reboot_work;

static void do_reboot(struct k_work *work)
{
	int ret = boot_request_upgrade(BOOT_UPGRADE_TEST);
	if (ret)
	{
		LOG_ERR("boot_request_upgrade: %d", ret);
	}

	sys_reboot(0);
}

static int firmware_update_cb(u16_t obj_inst_id)
{
	LOG_INF("Executing firmware update");

	// Wait a few seconds before rebooting so that the lwm2m client has a chance
	// to acknowledge having received the Update signal.
	k_delayed_work_submit(&reboot_work, K_SECONDS(10));

	return 0;
}

static void *firmware_get_buf(u16_t obj_inst_id, u16_t res_id, u16_t res_inst_id, size_t *data_len)
{
	static u8_t firmware_buf[CONFIG_LWM2M_COAP_BLOCK_SIZE];
	*data_len = sizeof(firmware_buf);
	return firmware_buf;
}

static struct flash_img_context dfu_ctx;

static int firmware_block_received_cb(u16_t obj_inst_id, u16_t res_id, u16_t res_inst_id,
									  u8_t *data, u16_t data_len, bool last_block, size_t total_size)
{
#if defined(CONFIG_FOTA_ERASE_PROGRESSIVELY)
	static int last_offset = DT_FLASH_AREA_IMAGE_1_OFFSET;
#endif
	static u8_t percent_downloaded;
	static u32_t bytes_downloaded;
	u8_t downloaded;
	int ret = 0;

	if (total_size > FLASH_BANK_SIZE)
	{
		LOG_ERR("Artifact file size too big (%d)", total_size);
		return -EINVAL;
	}

	if (!data_len)
	{
		LOG_ERR("Data len is zero, nothing to write.");
		return -EINVAL;
	}

	/* Erase bank 1 before starting the write process */
	if (bytes_downloaded == 0)
	{
		flash_img_init(&dfu_ctx);
#if defined(CONFIG_FOTA_ERASE_PROGRESSIVELY)
		LOG_INF("Download firmware started, erasing progressively.");
		/* reset image data */
		ret = boot_invalidate_slot1();
		if (ret != 0)
		{
			LOG_ERR("Failed to reset image data in bank 1");
			goto cleanup;
		}
#else
		LOG_INF("Download firmware started, erasing second bank");
		ret = boot_erase_img_bank(FLASH_BANK1_ID);
		if (ret != 0)
		{
			LOG_ERR("Failed to erase flash bank 1");
			goto cleanup;
		}
#endif
	}

	bytes_downloaded += data_len;
	LOG_DBG("%d of %d bytes downloaded", bytes_downloaded, total_size);
	/* display a % downloaded, if it's different */
	if (total_size)
	{
		downloaded = bytes_downloaded * 100 / total_size;
	}
	else
	{
		/* Total size is empty when there is only one block */
		downloaded = 100;
	}

	if (downloaded > percent_downloaded)
	{
		percent_downloaded = downloaded;
		if (percent_downloaded % 10 == 0)
		{
			LOG_DBG("Flash %d%%", percent_downloaded);
		}
	}

#if defined(CONFIG_FOTA_ERASE_PROGRESSIVELY)
	/* Erase the sector that's going to be written to next */
	while (last_offset <
		   DT_FLASH_AREA_IMAGE_1_OFFSET + dfu_ctx.bytes_written +
			   DT_FLASH_ERASE_BLOCK_SIZE)
	{
		LOG_INF("Erasing sector at offset 0x%x", last_offset);
		flash_write_protection_set(flash_dev, false);
		ret = flash_erase(flash_dev, last_offset,
						  DT_FLASH_ERASE_BLOCK_SIZE);
		flash_write_protection_set(flash_dev, true);
		last_offset += DT_FLASH_ERASE_BLOCK_SIZE;
		if (ret)
		{
			LOG_ERR("Error %d while erasing sector", ret);
			goto cleanup;
		}
	}
#endif

	ret = flash_img_buffered_write(&dfu_ctx, data, data_len, last_block);
	if (ret < 0)
	{
		LOG_ERR("Failed to write flash block");
		goto cleanup;
	}

	if (!last_block)
	{
		/* Keep going */
		return ret;
	}

	if (total_size && (bytes_downloaded != total_size))
	{
		LOG_ERR("Early last block, downloaded %d, expecting %d",
				bytes_downloaded, total_size);
		ret = -EIO;
	}

cleanup:
#if defined(CONFIG_FOTA_ERASE_PROGRESSIVELY)
	last_offset = DT_FLASH_AREA_IMAGE_1_OFFSET;
#endif
	bytes_downloaded = 0;
	percent_downloaded = 0;

	return ret;
}

static int init_lwm2m_resources()
{
	LOG_INF("Firmware version: %s", CLIENT_FIRMWARE_VER);
	LOG_INF("Model number:     %s", CLIENT_MODEL_NUMBER);
	LOG_INF("Serial numbera:   %s", CLIENT_SERIAL_NUMBER);
	LOG_INF("Manufacturer:     %s", CLIENT_MANUFACTURER);

	LOG_INF("This is the new version of the firmware!");

	char *server_url;
	u16_t server_url_len;
	u8_t server_url_flags;
	int ret = lwm2m_engine_get_res_data("0/0/0", (void **)&server_url, &server_url_len, &server_url_flags);
	if (ret)
	{
		LOG_ERR("Error getting LwM2M server URL data: %d", ret);
		return ret;
	}
	snprintk(server_url, server_url_len, "coap://172.16.15.14:5683");

	// Security Mode (3 == NoSec)
	ret = lwm2m_engine_set_u8("0/0/2", 3);
	if (ret)
	{
		LOG_ERR("Error setting LwM2M security mode: %d", ret);
		return ret;
	}

	// Firmware pull uses the buffer set by the Package resource (5/0/0) pre-write callback
	// for passing downloaded firmware chunks to the firmware write callback.
	lwm2m_engine_register_pre_write_callback("5/0/0", firmware_get_buf);
	lwm2m_firmware_set_write_cb(firmware_block_received_cb);

	lwm2m_engine_set_res_data("3/0/0", CLIENT_MANUFACTURER,
							  sizeof(CLIENT_MANUFACTURER),
							  LWM2M_RES_DATA_FLAG_RO);

	lwm2m_engine_set_res_data("3/0/1", CLIENT_MODEL_NUMBER,
							  sizeof(CLIENT_MODEL_NUMBER),
							  LWM2M_RES_DATA_FLAG_RO);

	lwm2m_engine_set_res_data("3/0/2", CLIENT_SERIAL_NUMBER,
							  sizeof(CLIENT_SERIAL_NUMBER),
							  LWM2M_RES_DATA_FLAG_RO);

	lwm2m_engine_set_res_data("3/0/3", CLIENT_FIRMWARE_VER,
							  sizeof(CLIENT_FIRMWARE_VER),
							  LWM2M_RES_DATA_FLAG_RO);

	k_delayed_work_init(&reboot_work, do_reboot);
	lwm2m_firmware_set_update_cb(firmware_update_cb);

	return 0;
}

static int init_image()
{
	// If we are updating but have booted into a confirmed image, it means
	// the test reboot failed and we have reverted to the old image.
	// TODO: Do a different check when updating modem firmware.
	if (boot_is_img_confirmed())
	{
		LOG_ERR("Firmware update failed");
		lwm2m_engine_set_u8("5/0/5", RESULT_UPDATE_FAILED);
		return 0;
	}

	LOG_INF("Firmware update succeeded");
	lwm2m_engine_set_u8("5/0/5", RESULT_SUCCESS);

	int ret = boot_write_img_confirmed();
	if (ret)
	{
		LOG_ERR("confirm image: %d", ret);
		return ret;
	}
	return 0;
}

static char endpoint_name[20];

static int init_endpoint_name()
{
	strcpy(endpoint_name, "nrf52");
	return 0;
}

int fota_init()
{
	int ret = init_lwm2m_resources();
	if (ret)
	{
		LOG_ERR("init_lwm2m_resources: %d", ret);
		return ret;
	}

	ret = init_image();
	if (ret)
	{
		LOG_ERR("init_image: %d", ret);
		return ret;
	}

	ret = init_endpoint_name();
	if (ret)
	{
		return ret;
	}

	static struct lwm2m_ctx client;
	lwm2m_rd_client_start(&client, endpoint_name, NULL);

	return 0;
}
```

## src/fota.h
```c
#pragma once

// This is the reported manufacturer reported by the LwM2M client. It is an
// arbitrary string and will be exposed through the Horde API.
#define CLIENT_MANUFACTURER "Exploratory Engineering"

// This is the model number reported by the LwM2M client. It is an arbitrary
// string and will be exposed by the Horde API.
#define CLIENT_MODEL_NUMBER "EE-N2-00"

// This is the serial number reported by the LwM2M client. If you have some
// kind of serial number available you can use that, otherwise the IMEI (the
// ID for the cellular modem) or IMSI (The ID of the SIM in use)
#define CLIENT_SERIAL_NUMBER "1"

// This is the version of the firmware. This must match the versions set on the
// images uploaded via the Horde API (at https://api.nbiot.engineering/)
#define CLIENT_FIRMWARE_VER "1.2.0"

int fota_init();
```

## src/n2_offload.c
```c
/*
 * Copyright (c) 2018 Foundries.io
 *
 * SPDX-License-Identifier: Apache-2.0
 */

#define LOG_LEVEL LOG_LEVEL_INF
#include <logging/log.h>
LOG_MODULE_REGISTER(n2_offload);

#include <stdio.h>
#include <stdbool.h>
#include <zephyr/types.h>
#include <errno.h>
#include <zephyr.h>
#include <device.h>
#include <init.h>
#include <net/net_offload.h>
#include <net/socket_offload.h>
#include <stdio.h>

#include "config.h"
#include "comms.h"
#include "at_commands.h"

// The maximum number of sockets in SARA N2 is 7
#define MDM_MAX_SOCKETS 7
#define INVALID_FD -1
#define MAX_RECEIVE 512

struct n2_socket
{
    int id;
    int in_use;
    bool connected;
    int local_port;
    ssize_t incoming_len;
    void *remote_addr;
    ssize_t remote_len;
};

static struct n2_socket sockets[MDM_MAX_SOCKETS];

static int next_free_port = 6000;

#define CMD_BUFFER_SIZE 64
static char modem_command_buffer[CMD_BUFFER_SIZE];

#define CMD_TIMEOUT 2000

#define TO_HEX(i) (i <= 9 ? '0' + i : 'A' - 10 + i)
#define S_TO_I(s) (s - 100)
#define I_TO_S(i) (i + 100)
#define VALID_SOCKET(s) (s >= 100 && s <= (100 + MDM_MAX_SOCKETS) && sockets[s-100].in_use)

static struct k_sem mdm_sem;

/**
 * @brief Clear socket state
 */
static void clear_socket(int sock_fd)
{
    sockets[sock_fd].id = -1;
    sockets[sock_fd].connected = false;
    sockets[sock_fd].in_use = false;
    sockets[sock_fd].local_port = 0;
    sockets[sock_fd].incoming_len = 0;
    sockets[sock_fd].remote_len = 0;
    if (sockets[sock_fd].remote_addr != NULL)
    {
        k_free(sockets[sock_fd].remote_addr);
        sockets[sock_fd].remote_addr = NULL;
    }
}

static int offload_close(int sfd)
{
    if (!VALID_SOCKET(sfd))
    {
        return -EINVAL;
    }
    int sock_fd = S_TO_I(sfd);
    k_sem_take(&mdm_sem, K_FOREVER);
    sprintf(modem_command_buffer, "AT+NSOCL=%d\r", sockets[sock_fd].id);
    modem_write(modem_command_buffer);

    if (atnsocl_decode() != AT_OK)
    {
        k_sem_give(&mdm_sem);
        return -ENOMEM;
    }
    clear_socket(sock_fd);
    k_sem_give(&mdm_sem);
    return 0;
}

static int offload_connect(int sfd, const struct sockaddr *addr,
                           socklen_t addrlen)
{
    if (!VALID_SOCKET(sfd))
    {
        return -EINVAL;
    }
    int sock_fd = S_TO_I(sfd);
    k_sem_take(&mdm_sem, K_FOREVER);
    // Find matching socket, then check if it created on the modem. It shouldn't be created
    if (!sockets[sock_fd].in_use)
    {
        k_sem_give(&mdm_sem);
        return -EISCONN;
    }

    sockets[sock_fd].connected = true;
    sockets[sock_fd].remote_addr = k_malloc(addrlen);
    memcpy(sockets[sock_fd].remote_addr, addr, addrlen);
    k_sem_give(&mdm_sem);
    return 0;
}

static int offload_poll(struct pollfd *fds, int nfds, int msecs)
{
    // Not *quite* how it should behave but close enough.
    if (msecs > 0) {
        k_sleep(msecs);
    }
    k_sem_take(&mdm_sem, K_FOREVER);
    for (int i = 0; i < nfds; i++)
    {
        if (!VALID_SOCKET(fds[i].fd))
        {
            fds[i].revents = POLLNVAL;
            continue;
        }
        fds[i].revents = POLLOUT;
        if (sockets[S_TO_I(fds[i].fd)].incoming_len > 0)
        {
            fds[i].revents |= POLLIN;
        }
    }
    k_sem_give(&mdm_sem);
    return 0;
}

static int offload_recvfrom(int sfd, void *buf, short int len,
                            short int flags, struct sockaddr *from,
                            socklen_t *fromlen)
{
    ARG_UNUSED(flags);
    if (!VALID_SOCKET(sfd))
    {
        return -EINVAL;
    }
    int sock_fd = S_TO_I(sfd);
    k_sem_take(&mdm_sem, K_FOREVER);

    // Now here's an interesting bit of information: If you send AT+NSORF *before*
    // you receive the +NSONMI URC from the module you'll get just three fields
    // in return: socket, data, remaining. IT WOULD HAVE BEEN REALLY NICE IF THE
    // DOCUMENTATION INCLUDED THIS.

    if (sockets[sock_fd].incoming_len == 0)
    {
        k_sem_give(&mdm_sem);
        errno = EWOULDBLOCK;
        return 0;
    }

    // Use NSORF to read incoming data.
    memset(modem_command_buffer, 0, sizeof(modem_command_buffer));
    if (len > MAX_RECEIVE) {
        len = MAX_RECEIVE;
    }
    sprintf(modem_command_buffer, "AT+NSORF=%d,%d\r", sockets[sock_fd].id, len);
    modem_write(modem_command_buffer);

    char ip[16];
    int port = 0;
    size_t remain = 0;
    int sockfd = 0;
    size_t received = 0;

    int res = atnsorf_decode(&sockfd, ip, &port, buf, &received, &remain);
    if (res == AT_OK)
    {
        if (received == 0)
        {
            k_sem_give(&mdm_sem);
            return 0;
        }
        if (fromlen != NULL)
        {
            *fromlen = sizeof(struct sockaddr_in);
        }
        if (from != NULL)
        {
            ((struct sockaddr_in *)from)->sin_family = AF_INET;
            ((struct sockaddr_in *)from)->sin_port = htons(port);
            inet_pton(AF_INET, ip, &((struct sockaddr_in *)from)->sin_addr);
        }
        sockets[sock_fd].incoming_len = remain;
        k_sem_give(&mdm_sem);
        return received;
    }
    k_sem_give(&mdm_sem);
    errno = -ENOMEM;
    return -ENOMEM;
}

static int offload_recv(int sfd, void *buf, size_t max_len, int flags)
{
    ARG_UNUSED(flags);

    if (!VALID_SOCKET(sfd))
    {
        return -EINVAL;
    }
    int sock_fd = S_TO_I(sfd);
    k_sem_take(&mdm_sem, K_FOREVER);
    if (!sockets[sock_fd].connected)
    {
        k_sem_give(&mdm_sem);
        return -EINVAL;
    }

    if (sockets[sock_fd].incoming_len == 0 && ((flags & MSG_DONTWAIT) == MSG_DONTWAIT))
    {
        k_sem_give(&mdm_sem);
        errno = EWOULDBLOCK;
        return 0;
    }

    int curcount = sockets[sock_fd].incoming_len;
    k_sem_give(&mdm_sem);

    while (curcount == 0)
    {
        // busy wait for data
        k_sleep(1000);
        k_sem_take(&mdm_sem, K_FOREVER);
        curcount = sockets[sock_fd].incoming_len;
        k_sem_give(&mdm_sem);
    }
    return offload_recvfrom(sfd, buf, max_len, flags, NULL, NULL);
}

static int offload_sendto(int sfd, const void *buf, size_t len,
                          int flags, const struct sockaddr *to,
                          socklen_t tolen)
{
    if (!VALID_SOCKET(sfd))
    {
        return -EINVAL;
    }

    if (len > CONFIG_N2_MAX_PACKET_SIZE)
    {
        return -EINVAL;
    }
    int sock_fd = S_TO_I(sfd);
    k_sem_take(&mdm_sem, K_FOREVER);

    struct sockaddr_in *toaddr = (struct sockaddr_in *)to;

    char addr[64];
    if (!inet_ntop(AF_INET, &toaddr->sin_addr, addr, 128))
    {
        // couldn't read address. Bail out
        k_sem_give(&mdm_sem);
        return -EINVAL;
    }

    sprintf(modem_command_buffer,
            "AT+NSOST=%d,\"%s\",%d,%d,\"",
            sockets[sock_fd].id, addr,
            ntohs(toaddr->sin_port),
            len);

    modem_write(modem_command_buffer);

    char byte[3];
    for (int i = 0; i < len; i++)
    {
        byte[0] = TO_HEX((((const char *)buf)[i] >> 4));
        byte[1] = TO_HEX((((const char *)buf)[i] & 0xF));
        byte[2] = 0;
        modem_write(byte);
    }

    modem_write("\"\r");

    int written = len;
    int fd = -1;
    size_t sent = 0;
    switch (atnsost_decode(&fd, &sent))
    {
    case AT_OK:
        break;
    case AT_ERROR:
        written = -ENOMEM;
        break;
    case AT_TIMEOUT:
        written = -ENOMEM;
        break;
    }
    k_sem_give(&mdm_sem);

    return written;
}

static int offload_send(int sfd, const void *buf, size_t len, int flags)
{
    if (!VALID_SOCKET(sfd))
    {
        return -EINVAL;
    }
    int sock_fd = S_TO_I(sfd);
    k_sem_take(&mdm_sem, K_FOREVER);

    if (!sockets[sock_fd].connected)
    {
        k_sem_give(&mdm_sem);
        return -ENOTCONN;
    }
    k_sem_give(&mdm_sem);
    int ret = offload_sendto(sfd, buf, len, flags,
                             sockets[sock_fd].remote_addr, sockets[sock_fd].remote_len);
    return ret;
}

static int offload_socket(int family, int type, int proto)
{
    if (family != AF_INET)
    {
        return -EAFNOSUPPORT;
    }
    if (type != SOCK_DGRAM)
    {
        return -ENOTSUP;
    }
    if (proto != IPPROTO_UDP)
    {
        return -ENOTSUP;
    }

    k_sem_take(&mdm_sem, K_FOREVER);
    int fd = INVALID_FD;
    for (int i = 0; i < MDM_MAX_SOCKETS; i++) {
        if (!sockets[i].in_use) {
            fd = i;
            break;
        }
    }
    if (fd == INVALID_FD) {
        k_sem_give(&mdm_sem);
        return -ENOMEM;
    }
    sockets[fd].local_port = next_free_port;
    sprintf(modem_command_buffer, "AT+NSOCR=\"DGRAM\",17,%d,1\r", sockets[fd].local_port);
    modem_write(modem_command_buffer);

    int sockfd = -1;
    if (atnsocr_decode(&sockfd) == AT_OK)
    {
        sockets[fd].id = sockfd;
        sockets[fd].in_use = true;
        next_free_port++;
        k_sem_give(&mdm_sem);
        return I_TO_S(fd);
    }
    k_sem_give(&mdm_sem);
    return -ENOMEM;
}

// We're only interested in socket(), close(), connect(), poll()/POLLIN, send() and recvfrom()
// since that's what the lwm2m client/coap library uses.
// bind(), accept(), fctl(), freeaddrinfo(), getaddrinfo(), setsockopt(),
// getsockopt() and listen() is not implemented
static const struct socket_offload n2_socket_offload = {
    .socket = offload_socket,
    .close = offload_close,
    .connect = offload_connect,
    .poll = offload_poll,
    .recv = offload_recv,
    .recvfrom = offload_recvfrom,
    .send = offload_send,
    .sendto = offload_sendto,
};

static int dummy_offload_get(sa_family_t family,
                             enum net_sock_type type,
                             enum net_ip_protocol ip_proto,
                             struct net_context **context)
{
    return -ENOTSUP;
}

// Zephyr doesn't like a null offload so we'll use a dummy offload here.
static struct net_offload offload_funcs = {
    .get = dummy_offload_get,
};

// Offload the interface. This will set the dummy offload functions then
// the socket offloading.
static void offload_iface_init(struct net_if *iface)
{
    for (int i = 0; i < MDM_MAX_SOCKETS; i++)
    {
        sockets[i].id = -1;
        sockets[i].remote_addr = NULL;
    }
    iface->if_dev->offload = &offload_funcs;
    socket_offload_register(&n2_socket_offload);
}

static struct net_if_api api_funcs = {
    .init = offload_iface_init,
};

static void receive_cb(int fd, size_t bytes)
{
    k_sem_take(&mdm_sem, K_FOREVER);
    for (int i = 0; i < MDM_MAX_SOCKETS; i++)
    {
        if (sockets[i].id == fd)
        {
            sockets[i].incoming_len += bytes;
        }
    }
    k_sem_give(&mdm_sem);
}

// _init initializes the network offloading
static int n2_init(struct device *dev)
{
    ARG_UNUSED(dev);

    k_sem_init(&mdm_sem, 1, 1);

    receive_callback(receive_cb);

    modem_init();

    modem_write("AT+NSOCL=0\r");
    at_decode();
    modem_write("AT+NSOCL=1\r");
    at_decode();
    modem_write("AT+NSOCL=2\r");
    at_decode();
    modem_write("AT+NSOCL=3\r");
    at_decode();
    modem_write("AT+NSOCL=4\r");
    at_decode();
    modem_write("AT+NSOCL=5\r");
    at_decode();
    modem_write("AT+NSOCL=6\r");
    at_decode();

    modem_restart();


    LOG_INF("Waiting for modem to connect...");
    while (!modem_is_ready())
    {
        k_sleep(K_MSEC(2000));
    }
    modem_write("AT+CIMI\r");
    char imsi[24];
    if (atcimi_decode((char *)&imsi) != AT_OK)
    {
        LOG_ERR("Unable to retrieve IMSI from modem");
    }
    else
    {
        LOG_INF("IMSI for modem is %s", log_strdup(imsi));
    }

    return 0;
}

struct n2_iface_ctx
{
};

static struct n2_iface_ctx n2_ctx;

NET_DEVICE_OFFLOAD_INIT(sara_n2, CONFIG_N2_NAME,
                        n2_init, &n2_ctx, NULL,
                        CONFIG_N2_INIT_PRIORITY, &api_funcs,
                        CONFIG_N2_MAX_PACKET_SIZE);
```

## src/panic.c
```c
#include <stdio.h>

#include <zephyr.h>
#include <kernel.h>
#include <device.h>
#include <drivers/gpio.h>
#include "panic.h"

/*
struct k_thread panic_thread;

#define PANIC_THREAD_STACK_SIZE 512
#define PANIC_THREAD_PRIORITY (CONFIG_NUM_COOP_PRIORITIES-2)
K_THREAD_STACK_DEFINE(panic_thread_stack,
                      PANIC_THREAD_STACK_SIZE);
*/

static int last_cycle = 0;

/*
static struct k_sem panic_sem;

void panic_threadproc() {
    while (true) {
        k_sem_take(&panic_sem, K_FOREVER);
        printf("Panic process\n");
    }
}
*/

/* panic button feature */
void dont_panic(struct device *gpiob, struct gpio_callback *cb, u32_t pins)
{
    int cycle = k_cycle_get_32();
    if ((cycle - last_cycle) > 10000) {
        //k_sem_give(&panic_sem);
       	printf("PANIC @ %d!\n", cycle);
        last_cycle = cycle;
    }
}

void init_panic() {
    //k_sem_init(&panic_sem, 0, 1);
/*    k_thread_create(&panic_thread, panic_thread_stack,
                K_THREAD_STACK_SIZEOF(panic_thread_stack),
                (k_thread_entry_t)panic_threadproc,
                NULL, NULL, NULL, K_PRIO_COOP(PANIC_THREAD_PRIORITY), 0, K_NO_WAIT);*/


    struct device *gpio;
    struct gpio_callback gpio_cb;

	gpio = device_get_binding("GPIO_0");
	if (!gpio) {
		printk("Unable to get GPIO device\n");
		return;
	}

	gpio_pin_configure(gpio, BUTTON_PIN, GPIO_INT | GPIO_PUD_PULL_UP | GPIO_INT_EDGE | GPIO_INT_ACTIVE_LOW | GPIO_DIR_IN);

	gpio_init_callback(&gpio_cb, dont_panic, BIT(BUTTON_PIN));

	gpio_add_callback(gpio, &gpio_cb);
	gpio_pin_enable_callback(gpio, BUTTON_PIN);

    printf("Panic subsystem. Right\n");
}
```

## src/panic.h
```c
#pragma once

#define BUTTON_PIN 4

void init_panic();
```

## src/test_modem.c
```c
#include "config.h"
#include <logging/log.h>
#define LOG_LEVEL APP_LOG_LEVEL
LOG_MODULE_REGISTER(modem_test);

#include <zephyr.h>
#include <stdio.h>


#include "comms.h"
#include "at_commands.h"

#include "test_modem.h"

static int received = 0;
static void recv_cb(int sockfd, size_t len)
{
    LOG_INF("Got %d bytes on socket %d", len, sockfd);
    received = len;
}


void testModem()
{
    int sockfd = -1;

    receive_callback(recv_cb);

    modem_write("AT+NSOCR=\"DGRAM\",17,6001,1\r");
    if (atnsocr_decode(&sockfd) != AT_OK)
    {
        LOG_ERR("Unable to decode nsocr");
        return;
    }
    modem_write("AT\r");
    at_decode();

    modem_write("AT+NSOST=0,\"172.16.15.14\",1234,6,\"AABBAAAABBAA\"\r");
    int fd = -1;
    size_t size = 0;
    if (atnsost_decode(&fd, &size) != AT_OK)
    {
        LOG_ERR("NSOS sent error nsost");
        return;
    }
    LOG_INF("Message sent (fd=%d,len=%d), waiting for response", fd, size);

    while (received == 0)
    {
        k_sleep(1000);
    }
    char ip[32];
    char data[34];
    int port;
    memset(data, 0, sizeof(data));
    size_t received;
    size_t remaining;
    modem_write("AT+NSORF=0,32\r");
    if (atnsorf_decode(&sockfd, (char *)&ip, &port, (uint8_t *)&data, &received, &remaining) != AT_OK)
    {
        LOG_ERR("Unable to decode nsorf");
    }

    modem_write("AT+NSOCL=0\r");
    if (atnsocl_decode() != AT_OK)
    {
        LOG_ERR("Unable to decode nsocl");
    }
}
```

## src/test_udp.c
```c
#include "config.h"
#include <zephyr.h>
#include <stdio.h>
#include <net/socket.h>
#include "test_udp.h"

void testUDPCounter()
{
    printf("Counting bytes\n");
    int err;

    int sock = socket(AF_INET, SOCK_DGRAM, IPPROTO_UDP);
    if (sock < 0)
    {
        printf("Error opening socket: %d\n", sock);
        return;
    }

    static struct sockaddr_in remote_addr = {
        sin_family : AF_INET,
    };
    remote_addr.sin_port = htons(1234);

    net_addr_pton(AF_INET, "172.16.15.14", &remote_addr.sin_addr);

    err = connect(sock, (struct sockaddr *)&remote_addr, sizeof(remote_addr));
    if (err < 0)
    {
        printf("Unable to connect to backend: %d\n", err);
        close(sock);
        return;
    }

    char buffer[255];
    char dump[512];
    memset(dump, 0, sizeof(dump));
    memset(buffer, 0, sizeof(buffer));
    for (int i = 0; i < sizeof(buffer); i++) {
        buffer[i] = '.';
        int len = 21 + strlen(buffer);
        sprintf(dump, "%03d bytes on the wall%s", len, buffer);

        printf("Sending %d bytes\n", len);
        err = send(sock, dump, len, 0);
        if (err < len)
        {
            printf("Error sending (%d bytes sent): %d\n", len, err);
            close(sock);
            return;
        }

        k_sleep(2000);
    }
    close(sock);
}


#define UDP_MESSAGE "Hello there I'm the UDP message C"

void testUDP()
{
    int err = 0;
    int sock = socket(AF_INET, SOCK_DGRAM, IPPROTO_UDP);
    if (sock < 0)
    {
        printf("Error opening socket: %d\n", sock);
        return;
    }

    printf("Connecting\n");
    static struct sockaddr_in remote_addr = {
        sin_family : AF_INET,
    };
    remote_addr.sin_port = htons(1234);

    net_addr_pton(AF_INET, "172.16.15.14", &remote_addr.sin_addr);

    err = connect(sock, (struct sockaddr *)&remote_addr, sizeof(remote_addr));
    if (err < 0)
    {
        printf("Unable to connect to backend: %d\n", err);
        close(sock);
        return;
    }

    printf("Sending a single message\n");
    err = send(sock, UDP_MESSAGE, strlen(UDP_MESSAGE), 0);
    if (err < strlen(UDP_MESSAGE))
    {
        printf("Error sending: %d\n", err);
        close(sock);
        return;
    }

    printf("Wait for packet\n");

#define BUF_LEN 12
    u8_t buffer[BUF_LEN + 1];
    memset(buffer, 0, BUF_LEN);

    // receive first block and block
    err = recv(sock, buffer, BUF_LEN, 0);
    if (err <= 0)
    {
        printf("Error receiving: %d\n", err);
        close(sock);
        return;
    }
    buffer[err] = 0;
    printf("Received %d bytes (%s)\n", err, log_strdup(buffer));

    while (err > 0)
    {
        memset(buffer, 0, BUF_LEN);
        err = recv(sock, buffer, BUF_LEN, MSG_DONTWAIT);
        if (err > 0)
        {
            buffer[err] = 0;
            printf("Received %d bytes (%s)\n", err, log_strdup(buffer));
        }
        if (err < 0 && err != -EAGAIN) {
            printf("Error receiving: %d\n", err);
            close(sock);
            return;
        }
    }

    printf("Connected, sending final message...\n");
    err = send(sock, UDP_MESSAGE, strlen(UDP_MESSAGE), 0);
    if (err < strlen(UDP_MESSAGE))
    {
        printf("Error sending: %d\n", err);
        close(sock);
        return;
    }

    close(sock);
    printf("Done socket\n");
}
```
